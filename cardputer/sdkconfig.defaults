## cardputer/sdkconfig.defaults
```kconfig
# sdkconfig.defaults - DEVELOPMENT baseline.
#
# Deliberately NOT enabled (one-way on the device, production only):
#   CONFIG_SECURE_BOOT_V2_ENABLED, CONFIG_SECURE_FLASH_ENC_ENABLED,
#   CONFIG_BOOTLOADER_APP_ANTI_ROLLBACK, CONFIG_NVS_ENCRYPTION
#
# After changing this file delete sdkconfig.cardputer_dev, or the change is
# ignored.

# --- Watchdogs --------------------------------------------------------------
CONFIG_ESP_TASK_WDT_EN=y
CONFIG_ESP_TASK_WDT_INIT=y
CONFIG_ESP_TASK_WDT_TIMEOUT_S=10
CONFIG_ESP_TASK_WDT_PANIC=y
CONFIG_ESP_INT_WDT=y
CONFIG_ESP_INT_WDT_TIMEOUT_MS=300

# --- Brownout ---------------------------------------------------------------
CONFIG_ESP_BROWNOUT_DET=y
CONFIG_ESP_BROWNOUT_DET_LVL_SEL_7=y

# --- Stack protection -------------------------------------------------------
CONFIG_COMPILER_STACK_CHECK_MODE_NORM=y
CONFIG_FREERTOS_CHECK_STACKOVERFLOW_CANARY=y

# --- Logging ----------------------------------------------------------------
CONFIG_LOG_DEFAULT_LEVEL_INFO=y
CONFIG_LOG_MAXIMUM_LEVEL_DEBUG=y
CONFIG_LOG_TIMESTAMP_SOURCE_RTOS=y

# --- FreeRTOS ---------------------------------------------------------------
CONFIG_FREERTOS_HZ=1000
CONFIG_FREERTOS_USE_TRACE_FACILITY=y
CONFIG_FREERTOS_GENERATE_RUN_TIME_STATS=y

# --- Bluetooth LE: NimBLE host, central role, host task on core 0 -----------
CONFIG_BT_ENABLED=y
CONFIG_BT_NIMBLE_ENABLED=y
CONFIG_BT_NIMBLE_PINNED_TO_CORE_0=y
CONFIG_BT_NIMBLE_HOST_TASK_STACK_SIZE=5120
CONFIG_BT_NIMBLE_MAX_CONNECTIONS=1

# --- Partition table --------------------------------------------------------
CONFIG_PARTITION_TABLE_CUSTOM=y
```
